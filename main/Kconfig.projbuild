## main/Kconfig.projbuild
```kconfig
# Copyright (C) 2024 EmbeddedSolutions.pl

rsource "modules/Kconfig"

menu "Main component"
  config APP_DEBUG
    bool "Enable debug options"
    imply FREERTOS_USE_TRACE_FACILITY
    imply FREERTOS_USE_STATS_FORMATTING_FUNCTIONS
    default n

  config APP_DEBUG_STATS_INTERVAL_MS
    int "RTOS Stats printout interval"
    depends on APP_DEBUG
    default 3600000

  config APP_IMAGE_CONFIRM_TIMEOUT_MS
    int "Application image confirm timeout"
    default 60000
    help
      New application has APP_IMAGE_CONFIRM_TIMEOUT_MS for passing the
      validity check and be confirmed to omit the rollback.

   config EM_DEVICE_NAME
    string "Name of the device for BLE and WiFi"
    default "ES-DEV"

endmenu
```

## main/modules/inverter/Kconfig.projbuild
```kconfig
# Copyright (C) 2024 EmbeddedSolutions.pl

menu "EM Inverter component"

endmenu
```

## main/modules/storage/Kconfig.projbuild
```kconfig
# Copyright (C) 2024 EmbeddedSolutions.pl

menu "EM Storage component"

  config EM_STORAGE_DUMP_DEBOUNCE_MS
    int "Debounce time of storage block dump"
    range 300 10000
    default 500

endmenu
```

## managed_components/em_ble_core/Kconfig.projbuild
```kconfig
# Copyright (C) 2025 EmbeddedSolutions.pl

menu "ES Advertising"
	config ES_ADVERTISING_INTERVAL_MS
		int "Advertising interval"
		default 0

endmenu
```

## managed_components/em_ble_prov_svc/Kconfig.projbuild
```kconfig
# Copyright (C) 2025 EmbeddedSolutions.pl

menu "ES BLE Prov service"

	config ES_DISCONNECTION_DEINIT_DELAY
		int "How many milliseconds after disconnection BLE is off"
		default 60000

endmenu
```

## managed_components/em_button/Kconfig.projbuild
```kconfig
# Copyright (C) 2024 EmbeddedSolutions.pl

menu "EM Button component"

    config EM_BUTTON_PIN
        int "Button pin number"
        default 9

    config EM_BUTTON_ACTIVE_LEVEL
        int "Button active level"
        range 0 1
        default 0
        help
            0 - Active Low
            1 - Active High

    config EM_BUTTON_MULTIPLE_CLICKS_NUM
        int "Button multiple clicks"
        range 3 4
        default 3
        help
            Number of subsequent button clicks
            which triggers BUTTON_MULTIPLE_CLICK event

    config EM_BUTTON_VERY_LONG_PRESS_TIME_MS
        int "Very long button press"
        range 8000 10000
        default 8000

    config EM_BUTTON_BREAK_TIME_MAX_MS
        int "Maximum time of break time"
        default 2000
        help
            3xClick -- Break -- VeryLong press.
            Maximum elapsed time between triple click
            and very long button press.

endmenu
```

## managed_components/em_coredump/Kconfig.projbuild
```kconfig
# Copyright (C) 2024 EmbeddedSolutions.pl

menu "EM Coredump component"
  config EM_COREDUMP_BLOCK_MAX_SIZE
    int "Maximum size of single Coredump data block"
    default 1024
endmenu
```

## managed_components/em_http_ota/Kconfig.projbuild
```kconfig
# Copyright (C) 2024 EmbeddedSolutions.pl

menu "EM HTTP OTA component"
    config EM_HTTP_OTA_TASK_PRIO
      int "HTTP OTA Task priority"
      default 5

    config EM_HTTP_OTA_TASK_STACK_SIZE
      int "HTTP OTA Task stack size"
      default 8192

    config EM_HTTP_OTA_MAX_QUEUE_MSGS
      int "HTTP OTA maximum submitted messages"
      default 3
      help
        Like START-ABORT-START

    config EM_HTTP_OTA_SERVER_HOSTNAME
      string "OTA Server hostname"
      default "api.embeddedsolutions.pl"

    config EM_HTTP_OTA_SERVER_PORT
      int "OTA Server port"
      default 35368

    config EM_HTTP_OTA_SERVER_TIMEOUT_MS
      int "OTA Server timeout"
      default 60000
      help
        How long application is suppose to wait for server response
        before it aborts OTA process.

    config EM_HTTP_OTA_REQ_SIZE
      int "Maximum request size for partial HTTP download"
      range 396 16384
      default 16384
      help
        Low range 396 -> sizeof(esp_image_header_t) + sizeof(esp_image_segment_header_t) + sizeof(esp_app_desc_t).
          Ensure that new application's descriptor is available on first server respond.
        High range 16384 -> Can be greater but requires testing.

    config EM_HTTP_OTA_QUEUE_SUBMIT_TIMEOUT_MS
      int "OTA queue submit timeout"
      default 10

    config EM_HTTP_OTA_PROGRESS_ACCURACY
      int "OTA progress accuracy"
      default 20
      help
        Value should be divisible by 100 without a remainder.

endmenu
```

## managed_components/em_led_scene/Kconfig.projbuild
```kconfig
# Copyright (C) 2024 EmbeddedSolutions.pl

# ToDo: Drivers may use the same periphs, solve that here

menu "EM LED component"
  config EM_LED_THREAD_STACK_SIZE
    int "LED Thread stack size"
    default 2048

  config EM_LED_THREAD_PRIO
    int "LED Thread priority"
    default 25

  config EM_LED_PWM
    bool "Single classic LED"
    default y

  config EM_LED_PWM_LED_PIN
    depends on EM_LED_PWM
    int "Single LED pin"
    default 2

  config EM_LED_PWM_LED_INVERT
    depends on EM_LED_PWM
    bool "PWM LED output inverted"
    default n

  config EM_LED_WS2812
    bool "RGB LED WS2812 strip"
    default y

  config EM_LED_WS2812_PIN
    int "LED pin number"
    depends on EM_LED_WS2812
    default 8

  config EM_LED_PWM_RGB
    bool "PWM LED RGB"
    default n

  if EM_LED_PWM_RGB
    config EM_LED_PWM_CHANNELS
      int "Number of PWM LED channels"
      default 3

    config EM_LED_R_PIN
      int "LED Red pin number"
      default 7

    config EM_LED_G_PIN
      int "LED Green pin number"
      default 5

    config EM_LED_B_PIN
      int "LED Blue pin number"
      default 4
  endif # EM_LED_PWM_RGB

  config EM_LED_PWM_RGB_INVERT
    depends on EM_LED_PWM_RGB
    bool "PWM RGB LED output inverted"
    default n

  config EM_LED_BRIGHTNESS_DIVIDER
    int "Default brightness of a LED"
    depends on EM_LED_PWM || EM_LED_PWM_RGB || EM_LED_WS2812
    range 1 10
    default 1

endmenu
```

## managed_components/em_scheduler/Kconfig.projbuild
```kconfig
# Copyright (C) 2024 EmbeddedSolutions.pl

menu "EM Scheduler component"

  config EM_SCHEDULER_MAX_ENTRIES
    int "Maximum number of scheduled callbacks"
    default 5

endmenu
```

## managed_components/em_serial_client/Kconfig.projbuild
```kconfig
# Copyright (C) 2024 EmbeddedSolutions.pl

menu "EM Serial Client component"
    config EM_SERIAL_CLIENT_TASK_PRIO
      int "Serial client task priority"
      default 7

    config EM_SERIAL_CLIENT_TASK_STACK_SIZE
      int "Serial client task stack size"
      default 5120

    config EM_SERIAL_CLIENT_MAX_PACKET_LEN
      int "Serial client maximum packet length"
      default 160

    config EM_SERIAL_CLIENT_MAX_RQS
      int "Serial client maximum requests"
      default 8

endmenu
```

## managed_components/em_slip/Kconfig.projbuild
```kconfig
# Copyright (C) 2024 EmbeddedSolutions.pl

menu "EM SLIP component"

  config EM_SLIP_ENCODED_DATA_BUF_SIZE
    int "Size of SLIP encoded data buffer"
    default 1536

  config EM_SLIP_DECODED_DATA_BUF_SIZE
    int "Size of SLIP decoded data buffer"
    range EM_SLIP_ENCODED_DATA_BUF_SIZE 8192
    default 2048

endmenu
```

## managed_components/em_sntp/Kconfig.projbuild
```kconfig
# Copyright (C) 2024 EmbeddedSolutions.pl

menu "EM SNTP component"

  config EM_SNTP_SERVER_PRIMARY
    string "SNTP server primary"
    default "tempus1.gum.gov.pl"
    help
      The Central Office of Measures provides the Internet service that allows
      time synchronization in computer systems with the official time in Poland.
      https://www.gum.gov.pl/en/services/time-service/187,Time-Service.html
      Instance: 1

  config EM_SNTP_SERVER_BACKUP
    string "SNTP server backup"
    default "tempus2.gum.gov.pl"
    help
      The Central Office of Measures provides the Internet service that allows
      time synchronization in computer systems with the official time in Poland.
      https://www.gum.gov.pl/en/services/time-service/187,Time-Service.html
      Instance: 2

  config EM_SNTP_LOCAL_TIMEZONE
    string "SNTP device local timezone"
    default "CET-1CEST,M3.5.0,M10.5.0/3"
    help
      Value here is used by setenv() and tzset() time API for setting device
      timezone.

  config EM_SNTP_TIMEZONE_CET
    int "SNTP Device CET"
    default 1
    help
      GMT+1 (CET)

endmenu
```

## managed_components/em_tcp_client/Kconfig.projbuild
```kconfig
# Copyright (C) 2024 EmbeddedSolutions.pl

menu "EM TCP Client component"
  config EM_TCP_RX_TASK_STACK_SIZE
      int "TCP RX stack size"
      default 16384

  config EM_TCP_RX_TASK_PRIO
      int "TCP RX stack priority"
      default 6

  config EM_TCP_RX_BUFFER_SIZE
      int "TCP RX buffer size"
      default 256

  config EM_TCP_RX_TASK_SLEEPTIME_MS
    int "TCP RX task sleeptime"
    range 10  500
    default 500
    help
      RX sleeptime if there is no data available on socket.
      Redo data availability check after sleeptime.

  config EM_TCP_TX_TASK_STACK_SIZE
      int "TCP TX stack size"
      default 6144

  config EM_TCP_TX_TASK_PRIO
      int "TCP TX stack priority"
      default 6

  config EM_TCP_CMD_MSG_Q_MAX
    int "Maximum number of command type messages in queue"
    default 8

  config EM_TCP_TX_SEND_MSG_Q_MAX
    int "Maximum number of send type messages in queue"
    default 8

  config EM_TCP_RX_STATE_MSG_Q_MAX
    int "Maximum number of state type messages in rx task queue"
    default 3

  config EM_TCP_MSG_SUBMIT_TIMEOUT_MS
    int "Timeout on submitting message to queue"
    default 10

  config EM_TCP_PORT
    int "TCP Port"
    default 35376

  config EM_TCP_HOSTNAME
    string "Hostname"
    default "api.embeddedsolutions.pl"

  config EM_TCP_RECONNECT_TIMEOUT_MS
    int "Time to wait before another reconnection attempt"
    default 5000

  config EM_TCP_CONN_RANDOM_DELAY_MS
    int "TCP connect/reconnect additionall random delay"
    range 0 5000
    default 2000
    help
      TCP connect/reconnect has 1000msec base delay.
      EM_TCP_CONN_RANDOM_RANGE_MS is added to the base delay;

  config EM_TCP_REBOOT_ON_MSG_DELAY_MS
    int "Delay before reboot on receiving reboot related message"
    range 100 1000
    default 1000

endmenu
```

## managed_components/em_uart/Kconfig.projbuild
```kconfig
# Copyright (C) 2025 EmbeddedSolutions.pl

menu "EM UART component"

    config EM_UART_PORT_NUM
        int "UART port number"
        default 0
        help
            UART communication port number for the example.
            See UART documentation for available port numbers.

    config EM_UART_RXD
        int "UART RXD pin number"
        default 20
        help
            GPIO number for UART RX pin. See UART documentation for more information
            about available pin numbers for UART.

    config EM_UART_TXD
        int "UART TXD pin number"
        default 21
        help
            GPIO number for UART TX pin. See UART documentation for more information
            about available pin numbers for UART.

    config EM_UART_TASK_STACK_SIZE
        int "UART task stack size"
        default 2048

    config EM_UART_TASK_PRIO
        int "UART task priority"
        default 8

    config EM_UART_RING_BUF_SIZE
        int "UART ring buf size"
        default 256

    config EM_UART_READ_BUF_SIZE
        int "UART read buf size"
        default 128

endmenu
```

## managed_components/em_utils/Kconfig.projbuild
```kconfig
# Copyright (C) 2024 EmbeddedSolutions.pl

menu "EM utils component"

  config EM_DEV_TYPE
      int "Device type, see enum dev_type_t"
      default 0

  config EM_HW_VER
    int "HW ver, see enum hw_ver_t"
    default 0

endmenu
```

## managed_components/em_wifi/Kconfig.projbuild
```kconfig
# Copyright (C) 2024 EmbeddedSolutions.pl

menu "EM WiFi component"
  # uncomment when APSTA is implemented
	#config EM_WIFI_AP_INITIALIZE_NET_IF
	#		bool "Initialize network interfaces"
	#		default y
	#		help
	#				If enabled, depending on the provisioning status wifi core calls:
	#				esp_netif_create_default_wifi_sta()
	#				OR
	#				esp_netif_create_default_wifi_ap()
	#				esp_netif_create_default_wifi_sta()

	config EM_WIFI_MAX_SCAN_RECORDS
		int "Maximum number of WiFi AP records"
		default 8
		help
				Limits the number of listed WiFi networks on server
				provisioning page.

  choice
    prompt "Wi-Fi storage location"
    default EM_WIFI_STORAGE_FLASH

  config EM_WIFI_STORAGE_FLASH
      bool "Store Wi-Fi data in FLASH"
      help
        Select this option to store Wi-Fi data in flash memory.

  config EM_WIFI_STORAGE_RAM
      bool "Store Wi-Fi data in RAM"
      help
        Select this option to store Wi-Fi data in RAM.

  endchoice

  config EM_WIFI_CREDENTIALS_STORAGE
      int
      default 0 if EM_WIFI_STORAGE_FLASH
      default 1 if EM_WIFI_STORAGE_RAM
      help
        Internal value for EM_WIFI_CREDENTIALS_STORAGE:
          0 = FLASH
          1 = RAM

endmenu
```

## sdkconfig.defaults
```kconfig
# Copyright (C) 2024 EmbeddedSolutions.pl

# Target ESP32C3-MINI-1-N4/H4
CONFIG_IDF_TARGET="esp32c3"
CONFIG_IDF_TARGET_ESP32C3=y
CONFIG_ESPTOOLPY_FLASHSIZE_4MB=y

# Versioning
CONFIG_APP_PROJECT_VER_FROM_CONFIG=y
CONFIG_APP_PROJECT_VER="0.0.2"

# System
CONFIG_ESP_MAIN_TASK_STACK_SIZE=4096
CONFIG_ESP_SYSTEM_EVENT_TASK_STACK_SIZE=4096
CONFIG_FREERTOS_TIMER_TASK_STACK_DEPTH=4096

# Coredump
CONFIG_ESP_COREDUMP_ENABLE_TO_FLASH=y
CONFIG_ESP_COREDUMP_MAX_TASKS_NUM=16
# Erase manually if Coredump sent successfully to server
CONFIG_ESP_COREDUMP_FLASH_NO_OVERWRITE=y
CONFIG_ESP_COREDUMP_STACK_SIZE=4096
CONFIG_ESP_COREDUMP_SUMMARY_STACKDUMP_SIZE=4096

# Heap tracing
CONFIG_HEAP_ABORT_WHEN_ALLOCATION_FAILS=y

# Partitions
CONFIG_PARTITION_TABLE_CUSTOM=y
CONFIG_PARTITION_TABLE_OFFSET=0xC000

# HTTP
CONFIG_HTTPD_MAX_REQ_HDR_LEN=1024

# Button
CONFIG_BUTTON_SHORT_PRESS_TIME_MS=700
CONFIG_BUTTON_LONG_PRESS_TIME_MS=3000
# this is deprecated CONFIG_BUTTON_LONG_PRESS_TOLERANCE_MS=100

# OTA
CONFIG_ESP_HTTPS_OTA_DECRYPT_CB=y

# Security
CONFIG_SECURE_SIGNED_APPS=y
CONFIG_SECURE_SIGNED_APPS_NO_SECURE_BOOT=y
CONFIG_SECURE_SIGNED_APPS_RSA_SCHEME=y
CONFIG_SECURE_SIGNED_ON_UPDATE=y
CONFIG_SECURE_SIGNED_ON_UPDATE_NO_SECURE_BOOT=y
CONFIG_SECURE_SIGNED_ON_BOOT=y
CONFIG_SECURE_SIGNED_ON_BOOT_NO_SECURE_BOOT=y
CONFIG_SECURE_BOOT_BUILD_SIGNED_BINARIES=y
CONFIG_SECURE_BOOT_SIGNING_KEY="cert/signing_key.pem"

# Bootloader
CONFIG_BOOTLOADER_APP_ROLLBACK_ENABLE=y

# SNTP
CONFIG_LWIP_SNTP_MAX_SERVERS=2
# Sync datetime each 6h
CONFIG_LWIP_SNTP_UPDATE_DELAY=21600000
CONFIG_LWIP_SNTP_MAXIMUM_STARTUP_DELAY=2000

# BLE
CONFIG_BT_ENABLED=y
CONFIG_BT_NIMBLE_ENABLED=y
CONFIG_BT_NIMBLE_MAX_CONNECTIONS=2
CONFIG_BT_NIMBLE_MAX_BONDS=2
CONFIG_BT_NIMBLE_SVC_GAP_DEVICE_NAME="ES-EP"
CONFIG_BT_NIMBLE_WHITELIST_SIZE=4
CONFIG_LWIP_LOCAL_HOSTNAME="ES-EP"
CONFIG_ES_ADVERTISING_INTERVAL_MS=0

# DEVICE
CONFIG_EM_DEV_TYPE=4
CONFIG_EM_DEVICE_NAME="ES-INV"

# UART
CONFIG_EM_UART_PORT_NUM=1
CONFIG_EM_UART_TXD=6
CONFIG_EM_UART_RXD=7
CONFIG_EM_UART_TASK_PRIO=24
CONFIG_EM_UART_RING_BUF_SIZE=64
CONFIG_EM_UART_READ_BUF_SIZE=128
CONFIG_EM_UART_TASK_STACK_SIZE=2560

# SERIAL CLIENT
CONFIG_EM_SERIAL_CLIENT_MAX_PACKET_LEN=64
CONFIG_EM_SERIAL_CLIENT_TASK_STACK_SIZE=4096
CONFIG_EM_SERIAL_CLIENT_TASK_PRIO=24
CONFIG_EM_SERIAL_CLIENT_MAX_RQS=5

# EM_WIFI
CONFIG_EM_WIFI_STORAGE_FLASH=y

# SCHEDULER
CONFIG_EM_SCHEDULER_MAX_ENTRIES=12

# TCP
CONFIG_LWIP_MAX_ACTIVE_TCP=4
CONFIG_LWIP_MAX_LISTENING_TCP=4

CONFIG_EM_TCP_RX_TASK_STACK_SIZE=8192
CONFIG_EM_TCP_TX_TASK_STACK_SIZE=6144

# STORAGE
CONFIG_EM_STORAGE_DUMP_DEBOUNCE_MS=700
```
